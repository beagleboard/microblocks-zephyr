## CMakeLists.txt
```
# SPDX-License-Identifier: Apache-2.0

cmake_minimum_required(VERSION 3.20.0)

cmake_path(SET ZephyrBase $ENV{ZEPHYR_BASE})

set(SMALLVM_PATH ../modules/microblocks/vm)
set(ARDUINO_ZEPHYR_PATH ${ZephyrBase}/../modules/lib/Arduino-Zephyr-API)

# get value of NORMALIZED_BOARD_TARGET early
find_package(Zephyr REQUIRED HINTS $ENV{ZEPHYR_BASE} COMPONENTS yaml boards)
set(EXTRA_DTC_OVERLAY_FILE ${ARDUINO_ZEPHYR_PATH}/variants/${BOARD}/${BOARD}.overlay)

find_package(Zephyr REQUIRED HINTS $ENV{ZEPHYR_BASE})
project(blinky)

target_include_directories(app PRIVATE ${SMALLVM_PATH})

file(GLOB VM ${SMALLVM_PATH}/*.c ${SMALLVM_PATH}/*.cpp)
target_sources(app PRIVATE ${VM})

target_sources_ifdef(CONFIG_LOG app PRIVATE src/log_backend.c)

target_sources(app PRIVATE src/main.c)

zephyr_compile_options(-Wno-unused-variable -Wno-comment)
```

## Kconfig
```
mainmenu "Microblocks Smallvm"

module = SMALLVM
module-str = smallvm
source "subsys/logging/Kconfig.template.log_config"

source "Kconfig.zephyr"
```

## west.yml
```
# Copyright (c) 2024 Ayush Singh <ayush@beagleboard.org>
# SPDX-License-Identifier: Apache-2.0

manifest:
  self:
    west-commands: scripts/west-commands.yml

  remotes:
    - name: zephyrproject-rtos
      url-base: https://github.com/zephyrproject-rtos

  projects:
    - name: zephyr
      remote: zephyrproject-rtos
      revision: main
      import:
        name-allowlist:
          - hal_ti
          - cmsis_6
    - name: gsoc-2022-arduino-core
      remote: zephyrproject-rtos
      path: modules/lib/Arduino-Zephyr-API
      revision: next
    - name: smallvm
      path: modules/microblocks
      revision: stable
      url: https://bitbucket.org/john_maloney/smallvm
```

## prj.conf
```kconfig
CONFIG_GPIO=y
CONFIG_ARDUINO_API=y
CONFIG_ARDUINO_ENTRY=n
CONFIG_SPI=y
CONFIG_PWM=y
CONFIG_ADC=y
CONFIG_GPIO_GET_DIRECTION=y

CONFIG_LOG=y
CONFIG_LOG_OUTPUT=y
CONFIG_LOG_MODE_IMMEDIATE=y
# CONFIG_LOG_BACKEND_SHOW_COLOR=n
CONFIG_LOG_BACKEND_FORMAT_TIMESTAMP=n
CONFIG_LOG_THREAD_ID_PREFIX=n
# CONFIG_HEAP_MEM_POOL_SIZE=8192
CONFIG_MAIN_STACK_SIZE=8192
CONFIG_ENTROPY_GENERATOR=y
CONFIG_FLASH=y
```

## boards/beagleconnect_freedom.overlay
```dts
/*
 * SPDX-License-Identifier: Apache-2.0
 *
 * Copyright (c) 2024 Ayush Singh <ayush@beagleboard.org>
 */

&flash0 {
	partitions {
		/* Allocate 568 KiB for persistance */
		persist_partition: partition@1F400 {
			reg = <0x0001F400 DT_SIZE_K(568)>;
		};
	};
};
```

## src/main.c
```c
/* This Source Code Form is subject to the terms of the Mozilla Public
 * License, v. 2.0. If a copy of the MPL was not distributed with this
 * file, You can obtain one at http://mozilla.org/MPL/2.0/. */

// Copyright 2018 John Maloney, Bernat Romagosa, and Jens Mönig

#include "interp.h"
#include "mem.h"
#include "persist.h"
#include <zephyr/logging/log.h>

LOG_MODULE_REGISTER(smallvm, CONFIG_SMALLVM_LOG_LEVEL);

int main(void) {
  hardwareInit();
  memInit();
  primsInit();
  outputString((char *)"Welcome to MicroBlocks!");
  restoreScripts();
  startAll();

  vmLoop();

  return 0;
}
```

## src/log_backend.c
```c
// SPDX-License-Identifier: Apache-2.0
/*
 * Copyright (c) 2024 Ayush Singh <ayush@beagleboard.org>
 */

#include "interp.h"
#include <zephyr/logging/log_backend.h>
#include <zephyr/logging/log_backend_std.h>
#include <zephyr/logging/log_output.h>

#define BUFFER_LEN 100

static uint8_t microblocks_output_buffer[BUFFER_LEN];

static int microblocks_out(uint8_t *data, size_t length, void *ctx) {
  ARG_UNUSED(ctx);

  data[length] = 0;
  outputString(data);

  return length;
}

LOG_OUTPUT_DEFINE(microblocks_log_output, microblocks_out,
                  microblocks_output_buffer, BUFFER_LEN - 1);

static void microblocks_backend_process(const struct log_backend *const backend,
                                        union log_msg_generic *msg) {
  ARG_UNUSED(backend);

  // uint32_t flags = log_backend_std_get_flags();
	uint32_t flags = LOG_OUTPUT_FLAG_LEVEL;

  log_output_msg_process(&microblocks_log_output, &msg->log, flags);
}

static void microblocks_backend_dropped(const struct log_backend *const backend,
                                        uint32_t cnt) {
  ARG_UNUSED(backend);

  log_backend_std_dropped(&microblocks_log_output, cnt);
}

static void microblocks_backend_panic(const struct log_backend *const backend) {
  ARG_UNUSED(backend);

  log_backend_std_panic(&microblocks_log_output);
}

static int
microblocks_backend_is_ready(const struct log_backend *const backend) {
  ARG_UNUSED(backend);

  if (ideConnected()) {
    return 0;
  } else {
    return -EBUSY;
  }
}

const struct log_backend_api microblocks_log_backend_api = {
    .process = microblocks_backend_process,
    .dropped = microblocks_backend_dropped,
    .panic = microblocks_backend_panic,
    .is_ready = microblocks_backend_is_ready};

LOG_BACKEND_DEFINE(microblocks_log_backend, microblocks_log_backend_api, true);
```
